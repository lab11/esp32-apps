## ble_multiple_connect/sdkconfig.defaults
```kconfig
# Auto-detect crystal frequency
CONFIG_ESP32_XTAL_FREQ_AUTO=y
CONFIG_ESP32_XTAL_FREQ=0

# Enable BLE
CONFIG_BT_ENABLED=y

# Disable Wi-Fi
CONFIG_WIFI_ENABLED=n

# Specify number of supported connections (up to 7)
CONFIG_BT_ACL_CONNECTIONS=4
```

## ble_wifi_config/sdkconfig.defaults
```kconfig
# Auto-detect crystal frequency
CONFIG_ESP32_XTAL_FREQ_AUTO=y
CONFIG_ESP32_XTAL_FREQ=0

# Enable BLE
CONFIG_BT_ENABLED=y

# Specify custom partitions (app requires extra memory)
CONFIG_PARTITION_TABLE_CUSTOM=y
CONFIG_PARTITION_TABLE_CUSTOM_FILENAME="partitions.csv"
CONFIG_PARTITION_TABLE_CUSTOM_APP_BIN_OFFSET=0x10000
CONFIG_PARTITION_TABLE_FILENAME="partitions.csv"
CONFIG_APP_OFFSET=0x10000
```

## gateway_ble_forwarding_udp/main/Kconfig.projbuild
```kconfig
menu "Wi-Fi Configuration"

config WIFI_SSID
    string "Wi-Fi SSID"
	default "myssid"
	help
		SSID (network name) for the app to connect to.

config WIFI_PASSWORD
    string "Wi-Fi Password"
	default "mypassword"
	help
		Wi-Fi password (WPA or WPA2) for the app to use.

		Can be left blank if the network has no security set.

endmenu

menu "UDP Endpoint"

	config UDP_ADDR
	string "Endpoint Address"
	default "0.0.0.1"
	help
		UDP Address
	
	config UDP_PORT
	int "Endpoint Port"
	default 1000
	help
		UDP Port
endmenu
```

## gateway_influx_config/main/Kconfig.projbuild
```kconfig
menu "Wi-Fi Configuration"

config WIFI_SSID
    string "Wi-Fi SSID"
	default "myssid"
	help
		SSID (network name) for the app to connect to.

config WIFI_PASSWORD
    string "Wi-Fi Password"
	default "mypassword"
	help
		Wi-Fi password (WPA or WPA2) for the app to use.

		Can be left blank if the network has no security set.

endmenu


menu "InfluxDB Configuration"

config HOST
	string "Default InfluxDB Host w/ protocol & port"
	default "https://my.influx.db:8086"
	help
		URL of the InfluxDB endpoint to which data should be sent.
		Include protocol (e.g. https://) & port (e.g :8086) as necessary.

config DB
	string "Default Influx Database Name"
	default "mydb"
	help
		Name of the database at the endpoint to which data should be sent.

endmenu
```

## gateway_influx_config/sdkconfig.defaults
```kconfig
# Auto-detect crystal frequency
CONFIG_ESP32_XTAL_FREQ_AUTO=y
CONFIG_ESP32_XTAL_FREQ=0

# Enable BLE
CONFIG_BT_ENABLED=y

# Task watchdog & reboot settings
CONFIG_TASK_WDT_PANIC=y
CONFIG_ESP32_PANIC_SILENT_REBOOT=y

# Specify custom partitions (app requires extra memory)
CONFIG_PARTITION_TABLE_CUSTOM=y
CONFIG_PARTITION_TABLE_CUSTOM_FILENAME="partitions.csv"
CONFIG_PARTITION_TABLE_CUSTOM_APP_BIN_OFFSET=0x10000
CONFIG_PARTITION_TABLE_FILENAME="partitions.csv"
CONFIG_APP_OFFSET=0x10000
```

## gateway_parse_batch_pb/main/Kconfig.projbuild
```kconfig
menu "Wi-Fi Configuration"

config WIFI_SSID
    string "Wi-Fi SSID"
	default "myssid"
	help
		SSID (network name) for the app to connect to.

config WIFI_PASSWORD
    string "Wi-Fi Password"
	default "mypassword"
	help
		Wi-Fi password (WPA or WPA2) for the app to use.

		Can be left blank if the network has no security set.

endmenu
```

## gateway_powerblade_thingspeak/main/Kconfig.projbuild
```kconfig
menu "Wi-Fi Configuration"

config WIFI_SSID
    string "Wi-Fi SSID"
	default "myssid"
	help
		SSID (network name) for the app to connect to.

config WIFI_PASSWORD
    string "Wi-Fi Password"
	default "mypassword"
	help
		Wi-Fi password (WPA or WPA2) for the app to use.

		Can be left blank if the network has no security set.

endmenu


menu "ThingSpeak Configuration"

config API
	string "ThingSpeak API Key"
	default "XXXXXXXXXXXXXXXX"
	help
		API Key for the destination ThingSpeak channel.

config POWERBLADE
	string "PowerBlade Address"
	default "c0:98:e5:70:00:00"
	help
		BLE address of the PowerBlade to receive advertisements from.
		Use colon-separated lowercase hex format (e.g. c0:98:e5:70:00:00).

endmenu
```

## gateway_time_sync/sdkconfig.defaults
```kconfig
# Auto-detect crystal frequency
CONFIG_ESP32_XTAL_FREQ_AUTO=y
CONFIG_ESP32_XTAL_FREQ=0

# Enable BLE
CONFIG_BT_ENABLED=y

CONFIG_TASK_WDT_CHECK_IDLE_TASK_CPU0=n
```

## http_post_url/sdkconfig.defaults
```kconfig
# Auto-detect crystal frequency
CONFIG_ESP32_XTAL_FREQ_AUTO=y
CONFIG_ESP32_XTAL_FREQ=0
```

## summon_lite/sdkconfig.defaults
```kconfig
# Override some defaults so BT stack is enabled
# and WiFi disabled by default in this example
CONFIG_BT_ENABLED=y
CONFIG_PARTITION_TABLE_CUSTOM=y
CONFIG_PARTITION_TABLE_CUSTOM_FILENAME="partitions.csv"
CONFIG_PARTITION_TABLE_CUSTOM_APP_BIN_OFFSET=0x10000
CONFIG_PARTITION_TABLE_FILENAME="partitions.csv"
CONFIG_APP_OFFSET=0x10000
```

## test_connect/central/main/Kconfig
```kconfig
choice DEVICE_ROLE
    prompt "Device Role"
    default CENTRAL_RECEIVE
    help
        Define device role: [Central - Receiving] reads data from [Peripheral - Sending]; [Central - Sending] writes data to [Peripheral - Receiving].

config CENTRAL_RECEIVE
    bool "Central - Receiving"
config CENTRAL_SEND
    bool "Central - Sending"
endchoice
```

## test_connect/peripheral/main/Kconfig
```kconfig
choice DEVICE_ROLE
    prompt "Device Role"
    default PERIPHERAL_SEND
    help
        Define device role: [Central - Receiving] reads data from [Peripheral - Sending]; [Central - Sending] writes data to [Peripheral - Receiving].

config PERIPHERAL_RECEIVE
    bool "Peripheral - Receiving"
config PERIPHERAL_SEND
    bool "Peripheral - Sending"
endchoice
```

## test_forward/sdkconfig.defaults
```kconfig
# Auto-detect crystal frequency
CONFIG_ESP32_XTAL_FREQ_AUTO=y
CONFIG_ESP32_XTAL_FREQ=0

# Enable BLE
CONFIG_BT_ENABLED=y

# Rock that baudy
CONFIG_CONSOLE_UART_BAUDRATE=921600
```

## test_influx_forward/main/Kconfig.projbuild
```kconfig
menu "Wi-Fi Configuration"

config WIFI_SSID
    string "Default Wi-Fi SSID"
	default "myssid"
	help
		SSID (network name) for the app to connect to.

config WIFI_PASSWORD
    string "Default Wi-Fi Password"
	default "mypassword"
	help
		Wi-Fi password (WPA or WPA2) for the app to use.

		Can be left blank if the network has no security set.

endmenu


menu "InfluxDB Configuration"

config HOST
	string "Default InfluxDB Host w/ protocol & port"
	default "https://my.influx.db:8086"
	help
		URL of the InfluxDB endpoint to which data should be sent.
		Include protocol (e.g. https://) & port (e.g :8086) as necessary.

config DATB
	string "Default Influx Database Name"
	default "mydb"
	help
		Name of the database at the endpoint to which data should be sent.

config USER
	string "Default Influx Username - Optional"
	default ""
	help
		Optional username for the endpoint to which data should be sent.

config PSWD
	string "Default Influx Password - Optional"
	default ""
	help
		Optional password for the endpoint to which data should be sent.

endmenu
```

## wifi_firmware_update/sdkconfig.defaults
```kconfig
# Auto-detect crystal frequency
CONFIG_ESP32_XTAL_FREQ_AUTO=y
CONFIG_ESP32_XTAL_FREQ=0

# Default sdkconfig parameters to use the OTA
# partition table layout, with a 4MB flash size
CONFIG_ESPTOOLPY_FLASHSIZE_4MB=y
CONFIG_PARTITION_TABLE_TWO_OTA=y
```
